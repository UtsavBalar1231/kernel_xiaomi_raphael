/* Copyright (c) 2015, The Linux Foundation. All rights reserved.
 * Copyright (C) 2019 XiaoMi, Inc.
 *
 * This program is free software; you can redistribute it and/or modify
 * it under the terms of the GNU General Public License version 2 and
 * only version 2 as published by the Free Software Foundation.
 *
 * This program is distributed in the hope that it will be useful,
 * but WITHOUT ANY WARRANTY; without even the implied warranty of
 * MERCHANTABILITY or FITNESS FOR A PARTICULAR PURPOSE.  See the
 * GNU General Public License for more details.
 */

/*---------------------------------------------------------------------------
 * This file is autogenerated file using gcdb parser. Please do not edit it.
 * Update input XML file to add a new entry or update variable in this file
 * VERSION = "1.0"
 *---------------------------------------------------------------------------*/
&soc {
	dsi_ss_fhd_ea8076_global_cmd: qcom,mdss_dsi_ss_fhd_ea8076_global_cmd {
		qcom,mdss-dsi-panel-name = "samsung ea8076 fhd global cmd dsi panel";
		qcom,mdss-dsi-panel-id = <0>;
		qcom,mdss-dsi-panel-model = "SAMSUNG FHD EA8076 CMD PANEL";
		qcom,mdss-dsi-panel-sleepwrmod = <0>;
		qcom,mdss-dsi-panel-type = "dsi_cmd_mode";

		qcom,mdss-dsi-virtual-channel-id = <0>;
		qcom,mdss-dsi-stream = <0>;
		qcom,mdss-dsi-bpp = <24>;
		qcom,mdss-dsi-underflow-color = <0xff>;
		qcom,mdss-dsi-border-color = <0>;

		qcom,mdss-dsi-traffic-mode = "non_burst_sync_event";
		qcom,mdss-dsi-lane-map = "lane_map_0123";
		qcom,mdss-dsi-lane-0-state;
		qcom,mdss-dsi-lane-1-state;
		qcom,mdss-dsi-lane-2-state;
		qcom,mdss-dsi-lane-3-state;

		qcom,bl-update-flag = "delay_until_first_frame";
		qcom,mdss-brightness-max-level = <2047>;
		qcom,mdss-dsi-bllp-eof-power-mode;
		qcom,mdss-dsi-bllp-power-mode;
		qcom,mdss-dsi-bl-dcs-type-ss;
		qcom,mdss-dsi-bl-pmic-control-type = "bl_ctrl_dcs";

		qcom,ulps-enabled;

		qcom,mdss-dsi-lp11-init;
		qcom,mdss-dsi-init-delay-us = <1000>;
		qcom,mdss-dsi-reset-sequence = <0 10>, <1 10>;

		qcom,mdss-pan-physical-width-dimension = <68>;
		qcom,mdss-pan-physical-height-dimension = <147>;

		qcom,mdss-dsi-te-pin-select = <1>;
		qcom,mdss-dsi-te-dcs-command = <1>;
		qcom,mdss-dsi-te-check-enable;
		qcom,mdss-dsi-te-using-te-pin;
		qcom,mdss-dsi-panel-status-check-mode = "te_signal_check";

		qcom,mdss-dsi-wr-mem-start = <0x2c>;
		qcom,mdss-dsi-wr-mem-continue = <0x3c>;
		qcom,mdss-dsi-dma-trigger = "trigger_sw";
		qcom,mdss-dsi-mdp-trigger = "none";
		qcom,mdss-dsi-tx-eot-append;

		qcom,mdss-dsi-panel-hdr-enabled;
		qcom,mdss-dsi-panel-hdr-color-primaries = <14500 15500 32000
			17000 15500 30000 8000 3000>;
		qcom,mdss-dsi-panel-peak-brightness = <4300000>;
		qcom,mdss-dsi-panel-blackness-level = <3230>;

		qcom,mdss-panel-on-dimming-delay = <120>;

		qcom,disp-doze-lpm-backlight = <20>;
		qcom,disp-doze-hbm-backlight = <266>;
		qcom,disp-fod-off-dimming-delay = <85>;
		qcom,disp-fod-dim-lut = <
		/* brightness, alpha */
			0	0xFF
			4	0xEB
			8	0xEA
			12	0xE9
			13	0xE8
			20	0xE5
			24	0xE3
			30	0xE0
			68	0xD0
			133	0xC0
			218	0xB0
			328	0xA0
			486	0x90
			642	0x80
			832	0x70
			1043	0x60
			1267	0x50
			1500	0x40
			1770	0x30
			2000	0x24
			2047	0x21
		>;

		qcom,mdss-dsi-display-timings {
			timing@0{
				qcom,mdss-dsi-panel-width = <1080>;
				qcom,mdss-dsi-panel-height = <2340>;
				qcom,mdss-dsi-h-front-porch = <64>;
				qcom,mdss-dsi-h-back-porch = <64>;
				qcom,mdss-dsi-h-pulse-width = <20>;
				qcom,mdss-dsi-h-sync-skew = <0>;
				qcom,mdss-dsi-h-sync-pulse = <0>;
				qcom,mdss-dsi-h-left-border = <0>;
				qcom,mdss-dsi-h-right-border = <0>;
				qcom,mdss-dsi-v-back-porch = <64>;
				qcom,mdss-dsi-v-front-porch = <64>;
				qcom,mdss-dsi-v-pulse-width = <27>;
				qcom,mdss-dsi-v-top-border = <0>;
				qcom,mdss-dsi-v-bottom-border = <0>;
				qcom,mdss-dsi-panel-framerate = <60>;
				qcom,mdss-dsi-panel-clockrate = <1103000000>;
				qcom,mdss-dsi-panel-jitter = <0x5 0x1>;
				qcom,mdss-dsi-on-command = [
					/* Sleep Out */
					05 01 00 00 0A 00 02 11 00

					/* Unlock */
					39 01 00 00 00 00 03 F0 5A 5A

					/* TE OUT(Vsync On) */
					39 01 00 00 00 00 02 35 00

					/* DBV Smooth Transition */
					39 01 00 00 00 00 03 B7 01 4B

					/* Lock */
					39 01 00 00 00 00 03 F0 A5 A5

					/* Page Address Set */
					39 01 00 00 00 00 05 2B 00 00 09 23

					/* Unlock */
					39 01 00 00 00 00 03 F0 5A 5A
					39 01 00 00 00 00 03 FC 5A 5A

					/* Set DDIC internal HFP */
					39 01 00 00 00 00 02 B0 23
					39 01 00 00 00 00 02 D1 0F

					/* ESD Setting */
					39 01 00 00 00 00 07 E1 00 00 02 02 42 02
					39 01 00 00 00 00 07 E2 00 00 00 00 00 00
					39 01 00 00 00 00 02 B0 0C
					39 01 00 00 00 00 02 E1 19

					/* OFC Setting */
					39 01 00 00 00 00 0C E9 11 55 A6 75 A3 B9 A1 4A 00 1A B8

					/* Lock */
					39 01 00 00 00 00 03 F0 A5 A5
					39 01 00 00 00 00 03 FC A5 A5

					/* Brightness Control */
					39 01 00 00 00 00 02 53 20
					39 01 00 00 00 00 03 51 00 00
					39 01 00 00 43 00 02 55 00

					/* Display On */
					05 01 00 00 00 00 02 29 00
				];
				qcom,mdss-dsi-on-command-state = "dsi_lp_mode";

				qcom,mdss-dsi-off-command = [
					/* Display Off */
					05 01 00 00 00 00 02 28 00

					/* Sleep In */
					05 01 00 00 78 00 02 10 00
				];
				qcom,mdss-dsi-off-command-state = "dsi_lp_mode";

				qcom,mdss-dsi-doze-hbm-command = [
					/* AOD ON Sequence (Normal To AOD HBM) */
					39 01 00 00 00 00 03 F0 5A 5A
					39 01 00 00 00 00 02 D4 8B
					39 01 00 00 00 00 02 B0 A5
					39 01 00 00 00 00 02 C7 00
					39 01 00 00 00 00 02 B0 69
					39 01 00 00 00 00 03 B9 08 8F
					39 01 00 00 01 00 02 53 22
					39 01 00 00 00 00 03 F0 A5 A5
				];
				qcom,mdss-dsi-doze-hbm-command-state = "dsi_lp_mode";

				qcom,mdss-dsi-doze-lbm-command = [
					/* AOD ON Sequence (Normal To AOD LBM) */
					39 01 00 00 00 00 03 F0 5A 5A
					39 01 00 00 00 00 02 D4 8B
					39 01 00 00 00 00 02 B0 A5
					39 01 00 00 00 00 02 C7 00
					39 01 00 00 00 00 02 B0 69
					39 01 00 00 00 00 03 B9 08 8F
					39 01 00 00 00 00 02 53 23
					39 01 00 00 00 00 03 F0 A5 A5
				];
				qcom,mdss-dsi-doze-lbm-command-state = "dsi_lp_mode";

				qcom,mdss-dsi-nolp-command = [
					/* AOD OFF Sequence (AOD To Normal) */
					05 01 00 00 10 00 02 28 00
					39 01 00 00 00 00 02 53 20
					05 01 00 00 00 00 02 29 00
				];
				qcom,mdss-dsi-nolp-command-state = "dsi_lp_mode";

				qcom,mdss-dsi-dispparam-hbm-off-command = [
					39 01 00 00 00 00 02 53 28
				];
				qcom,mdss-dsi-dispparam-hbm-off-command-state = "dsi_lp_mode";

				qcom,mdss-dsi-dispparam-hbm-on-command = [
					39 01 00 00 00 00 02 53 E8
				];
				qcom,mdss-dsi-dispparam-hbm-on-command-state = "dsi_lp_mode";

				qcom,mdss-dsi-dispparam-hbm-fod-off-command = [
					15 01 00 00 10 00 02 53 20
				];
				qcom,mdss-dsi-dispparam-hbm-fod-off-command-state = "dsi_hs_mode";

				qcom,mdss-dsi-dispparam-hbm-fod-on-command = [
					39 01 00 00 00 00 03 F0 5A 5A
					15 01 00 00 00 00 02 B0 03
					15 01 00 00 00 00 02 B7 C9
					39 01 00 00 00 00 03 F0 A5 A5
					15 01 00 00 10 00 02 53 E0];
				qcom,mdss-dsi-dispparam-hbm-fod-on-command-state = "dsi_hs_mode";
			};
		};
	};
};
