## Documentation/devicetree/bindings/leds/leds-qcom-clk.txt
```
Qualcomm Technologies, Inc. clock controller based PWM driver
------------------------------------------------------------

Qualcomm Technologies, Inc. provides clock controller to be connected to LED
to generate PWM. Driver for configuring duty cycle of clock to get the required
brightnes. Complete clock period/duty cycle is 100 and brightness is the
period in which signal is active.

Required properties:
- compatible: Should be "qcom,clk-led-pwm".
- clock_names: Should be "src_clk".
- clocks: Should contain the source clock.
- assgined-clocks: Should be same as source clock.
- assinged-clock-rates: Required frequency of the source clock.
- qcom,max_duty: Maximum duty cyles that can be set on the clock.
		   Should be less than 100.
- pinctrl-names: Property should contain "active" and "sleep" for the
		   pin configurations during the usecase and during idle.
- pinctrl-x: phandle to the default/sleep pin configurations.

Optional properties:
- qcom,label: Label for the sysfs node.


Example:

qcom_clk_led {
	compatible = "qcom,clk-led-pwm";
	qcom,label = "led_clk_pwm";
	qcom,max_duty = <80>;
	clocks = <&clock_gcc GCC_GP2_CLK>;
	clock-names = "src_clk";
	assigned-clocks = <&clock_gcc GCC_GP2_CLK>;
	assigned-clock-rates = <80000>;
	pinctrl-names = "active", "sleep";
	pinctrl-0 = <&qcom_clk_led_gp2_active>;
	pinctrl-1 = <&qcom_clk_led_gp2_sleep>;
};

qcom_clk_led_gp2_pins: qcom_clk_led_gp2_pins {
	qcom_clk_led_gp2_active: qcom_clk_led_gp2_active {
		mux {
			pins = "gpio21";
			function = "gcc_gp2";
		};

		config {
			pins = "gpio21";
			drive-strength = <2>;
			bias-disable;
		};
	};

	qcom_clk_led_gp2_sleep: qqcom_clk_led_gp2_sleep {
		mux {
			pins = "gpio21";
			function = "gpio";
		};

		config {
			pins = "gpio21";
			drive-strength = <2>;
			bias-pull-down;
		};
	};
};
```

## Documentation/devicetree/bindings/soc/qcom/qcom,early-devices.txt
```
* early-devices

Some initcall stage takes long time to finish and it's better we launch some
of our userspace applications earlier before these initcalls. This way, the
userspace applications we care after system booting can start to work earlier
and provide better user experience.
To achieve this, we need to populate and probe some platform devices earlier
(thus its name early-devices) since these devices are commonly needed by all
other subsystems. Usually this list of devices includes clock, regulator,
bus components, iommu, crypto device, etc. and it's soc related(depends on
how these devices are connected in hardware in specific soc).

Required properties:
- compatible:
	Usage: required for early-devices
	Value type: <stringlist>
	Definition: must be "qcom,early-devices"
- devices:
	Usage: required
	Value type: <phandle array>
	Definition: nodes handle for early devices.

Example:
	early-devices {
		compatible = "qcom,early-devices";
		devices = <&ufs_phy_gdsc &clock_rpmh &clock_gcc
			&ad_hoc_bus &ufs_ice &ufsphy_mem
			&ufshc_mem &apps_rsc &cmd_db
			&ldoa10 &ldoc5 &ldoc8
			&smpa4 &tlmm &ldoa5
			&cxlvl &mxlvl &bps_gdsc
			&ipe_0_gdsc &ipe_1_gdsc &ife_0_gdsc
			&ife_1_gdsc &titan_top_gdsc &mvsc_gdsc
			&mvs0_gdsc &mvs1_gdsc>;
	};
```

## Kconfig
```kconfig
# SPDX-License-Identifier: GPL-2.0
#
# For a description of the syntax of this configuration file,
# see Documentation/kbuild/kconfig-language.txt.
#
mainmenu "Linux/$ARCH $VERSION.$PATCHLEVEL Kernel Configuration"

config SRCARCH
	string
	option env="SRCARCH"

source "arch/$SRCARCH/Kconfig"
```

## drivers/gpu/drm/msm-lease/Kconfig
```kconfig
#
# Drm MSM lease configuration
#
# This driver provides support for the User Space DRM Masters
#
config DRM_MSM_LEASE
	tristate "MSM DRM LEASE"
	depends on DRM_MSM
	help
	  DRM/KMS driver for MSM/snapdragon in lease mode. This driver
	  registers with DRM framework to create /dev/dri/card<n>, n=1,2,...
	  and do internal object leasing from DRM_MSM device.
```

## drivers/media/platform/msm/npu/Kconfig
```kconfig
config MSM_NPU

	tristate "QTI MSM Neural Processing Unit support"
	depends on ARCH_QCOM
	---help---
	  Enable support for Neural Processing Unit
	  for specific QTI chipsets.
	  This module serves as the common driver
	  for npu which provides acceleration for neural
	  network processing.

config MSM_NPU_DEBUG_FS

	bool "debugging framework of QTI MSM Neural Processing Unit"
	depends on MSM_NPU || DEBUG_FS
	default n
```
